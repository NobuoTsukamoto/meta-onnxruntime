## conf/layer.conf
```bitbake
# We have a conf and classes directory, add to BBPATH
BBPATH .= ":${LAYERDIR}"

# We have recipes-* directories, add to BBFILES
BBFILES += "${LAYERDIR}/recipes-*/*/*.bb \
            ${LAYERDIR}/recipes-*/*/*.bbappend"

BBFILE_COLLECTIONS += "meta-onnxruntime"
BBFILE_PATTERN_meta-onnxruntime = "^${LAYERDIR}/"
BBFILE_PRIORITY_meta-onnxruntime = "6"

LAYERDEPENDS_meta-onnxruntime = "core meta-python"
LAYERSERIES_COMPAT_meta-onnxruntime = "wrynose whinlatter walnascar"
```
